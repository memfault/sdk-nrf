## Kconfig
```
#
# Copyright (c) 2024 Nordic Semiconductor
#
# SPDX-License-Identifier: LicenseRef-Nordic-5-Clause
#

config SETTINGS
	default y

config ZMS
	default y if (SOC_FLASH_NRF_RRAM || SOC_FLASH_NRF_MRAM)

config NVS
	default y if !(SOC_FLASH_NRF_RRAM || SOC_FLASH_NRF_MRAM)

### Memfault Device Identification settings ###
#
# There are 3 places device identification is used:
#
# | Field             | Memfault (NCS)          | Bluetooth DIS            | MCUboot                      |
# |-------------------|-------------------------|--------------------------|------------------------------|
# | .software_version | MEMFAULT_NCS_FW_VERSION | BT_DIS_FW_REV_STR        | MCUBOOT_IMGTOOL_SIGN_VERSION |
# | .software_type    | MEMFAULT_NCS_FW_TYPE    | BT_DIS_SW_REV_STR        | N/A                          |
# | .hardware_version | MEMFAULT_NCS_HW_VERSION | BT_DIS_HW_REV_STR        | N/A                          |
# | .device_serial    | MEMFAULT_NCS_DEVICE_ID  | BT_DIS_SERIAL_NUMBER_STR | N/A                          |
#
# How each is used:
# - Memfault uses these values to tag telemetry data sent to the Memfault cloud.
# - The Bluetooth Device Information Service (DIS) exposes these values over
#   BLE. These are used by the nRF Connect Device Manager app to execute FOTA
#   with nRF Cloud (Memfault). These values are required when performing the
#   FOTA requests.
# - MCUboot contains the .software_version in the image header, mostly used for
#   informational purposes.
#
# We use this Kconfig override file to set all 3 places simultaneously to ensure
# consistency.

# .software_version
config MEMFAULT_NCS_FW_VERSION
	# The MEMFAULT_BUILTIN_DEVICE_INFO_SOFTWARE_VERSION default uses the VERSION
	# file for the software version value
	default MEMFAULT_BUILTIN_DEVICE_INFO_SOFTWARE_VERSION
config MCUBOOT_IMGTOOL_SIGN_VERSION
	default MEMFAULT_NCS_FW_VERSION
config BT_DIS_FW_REV_STR
	default MEMFAULT_NCS_FW_VERSION

# .software_type
config MEMFAULT_NCS_FW_TYPE
	# Defaults to "app"
	default MEMFAULT_BUILTIN_DEVICE_INFO_SOFTWARE_TYPE
config BT_DIS_SW_REV_STR
	default MEMFAULT_NCS_FW_TYPE

# .hardware_version
config BT_DIS_HW_REV_STR
	default BOARD

# .device_serial
config MEMFAULT_NCS_DEVICE_ID
	default "mfltqs1"
config BT_DIS_SERIAL_NUMBER_STR
	default MEMFAULT_NCS_DEVICE_ID

source "Kconfig.zephyr"
```

## prj.conf
```kconfig
#
# Copyright (c) 2022 Nordic Semiconductor
#
# SPDX-License-Identifier: LicenseRef-Nordic-5-Clause
#

CONFIG_NCS_SAMPLES_DEFAULTS=y

CONFIG_BT=y
CONFIG_BT_SMP=y
CONFIG_BT_PERIPHERAL=y
CONFIG_BT_DEVICE_NAME="Nordic_Memfault"
CONFIG_BT_PRIVACY=y

CONFIG_BT_BAS=y
CONFIG_BT_MDS=y

CONFIG_BT_GATT_DYNAMIC_DB=y

CONFIG_BT_CTLR_PHY_2M=y
CONFIG_BT_BUF_ACL_RX_SIZE=251
CONFIG_BT_L2CAP_TX_MTU=247
CONFIG_BT_BUF_ACL_TX_SIZE=251
CONFIG_BT_CTLR_DATA_LENGTH_MAX=251

CONFIG_LOG=y
CONFIG_LOG_PRINTK=n
CONFIG_LOG_DEFAULT_LEVEL=2
CONFIG_LOG_MODE_DEFERRED=y
CONFIG_LOG_MODE_OVERFLOW=y
CONFIG_LOG_BACKEND_RTT=n

CONFIG_SHELL=y
CONFIG_SENSOR_SHELL=n
CONFIG_DK_LIBRARY=y

# Heap memory is required for the memfault_demo_cli.c
CONFIG_HEAP_MEM_POOL_SIZE=256

CONFIG_MEMFAULT=y
CONFIG_MEMFAULT_SHELL=y

CONFIG_MEMFAULT_NCS_PROJECT_KEY=""
CONFIG_MEMFAULT_NCS_DEVICE_ID=""

CONFIG_MEMFAULT_NCS_BT_METRICS=y

# Enable bonding
CONFIG_BT_SETTINGS=y
CONFIG_FLASH=y
CONFIG_FLASH_PAGE_LAYOUT=y
CONFIG_FLASH_MAP=y
CONFIG_NVS=y
CONFIG_SETTINGS=y

# This example requires more stack
CONFIG_MAIN_STACK_SIZE=1152
```

## src/main.c
```c
/*
 * Copyright (c) 2022 Nordic Semiconductor ASA
 *
 * SPDX-License-Identifier: LicenseRef-Nordic-5-Clause
 */

#include <zephyr/kernel.h>

#include <zephyr/bluetooth/bluetooth.h>
#include <zephyr/bluetooth/conn.h>
#include <zephyr/bluetooth/services/bas.h>
#include <zephyr/shell/shell.h>

#include <bluetooth/services/mds.h>

#include <zephyr/settings/settings.h>

#include <dk_buttons_and_leds.h>

#include <memfault/metrics/metrics.h>
#include <memfault/core/trace_event.h>

#define DEVICE_NAME     CONFIG_BT_DEVICE_NAME
#define DEVICE_NAME_LEN (sizeof(DEVICE_NAME) - 1)

#define RUN_STATUS_LED DK_LED1
#define CON_STATUS_LED DK_LED2

#define RUN_LED_BLINK_INTERVAL 1000

static const struct bt_data ad[] = {
	BT_DATA_BYTES(BT_DATA_FLAGS, (BT_LE_AD_GENERAL | BT_LE_AD_NO_BREDR)),
	BT_DATA_BYTES(BT_DATA_UUID128_ALL, BT_UUID_MDS_VAL),
};

static const struct bt_data sd[] = {
	BT_DATA(BT_DATA_NAME_COMPLETE, DEVICE_NAME, DEVICE_NAME_LEN),
};

static struct bt_conn *pairing_confirmation_conn;
static struct bt_conn *mds_conn;

static void bas_work_handler(struct k_work *work);

static K_WORK_DELAYABLE_DEFINE(bas_work, bas_work_handler);

static void security_changed(struct bt_conn *conn, bt_security_t level,
			     enum bt_security_err err)
{
	char addr[BT_ADDR_LE_STR_LEN];

	bt_addr_le_to_str(bt_conn_get_dst(conn), addr, sizeof(addr));

	if (!err) {
		printk("Security changed: %s level %u\n", addr, level);
	} else {
		printk("Security failed: %s level %u err %d\n", addr, level,
			err);
	}

	if (level >= BT_SECURITY_L2) {
		if (!mds_conn) {
			mds_conn = conn;
		}
	}
}

static void connected(struct bt_conn *conn, uint8_t conn_err)
{
	char addr[BT_ADDR_LE_STR_LEN];

	if (conn_err) {
		printk("Connection failed (err %u)\n", conn_err);
		return;
	}

	bt_addr_le_to_str(bt_conn_get_dst(conn), addr, sizeof(addr));
	printk("Connected %s\n", addr);

	dk_set_led_on(CON_STATUS_LED);
}

static void disconnected(struct bt_conn *conn, uint8_t reason)
{
	printk("Disconnected (reason %u)\n", reason);

	dk_set_led_off(CON_STATUS_LED);

	if (conn == mds_conn) {
		mds_conn = NULL;
	}
}

BT_CONN_CB_DEFINE(conn_callbacks) = {
	.connected = connected,
	.disconnected = disconnected,
	.security_changed = security_changed
};

static void pairing_complete(struct bt_conn *conn, bool bonded)
{
	char addr[BT_ADDR_LE_STR_LEN];

	bt_addr_le_to_str(bt_conn_get_dst(conn), addr, sizeof(addr));

	printk("Pairing completed: %s, bonded: %d\n", addr, bonded);
}

static void pairing_failed(struct bt_conn *conn, enum bt_security_err reason)
{
	char addr[BT_ADDR_LE_STR_LEN];

	bt_addr_le_to_str(bt_conn_get_dst(conn), addr, sizeof(addr));

	printk("Pairing failed conn: %s, reason %d\n", addr, reason);

	if (pairing_confirmation_conn) {
		pairing_confirmation_conn = NULL;
	}
}

static struct bt_conn_auth_info_cb conn_auth_info_callbacks = {
	.pairing_complete = pairing_complete,
	.pairing_failed = pairing_failed
};

static void auth_cancel(struct bt_conn *conn)
{
	char addr[BT_ADDR_LE_STR_LEN];

	bt_addr_le_to_str(bt_conn_get_dst(conn), addr, sizeof(addr));

	printk("Pairing cancelled: %s\n", addr);
}

static void pairing_confirm(struct bt_conn *conn)
{
	char addr[BT_ADDR_LE_STR_LEN];

	bt_addr_le_to_str(bt_conn_get_dst(conn), addr, sizeof(addr));

	pairing_confirmation_conn = conn;

	printk("Pairing confirmation required for %s\n", addr);
	printk("Press Button 1 to confirm, Button 2 to reject.\n");
}

static struct bt_conn_auth_cb conn_auth_callbacks = {
	.cancel = auth_cancel,
	.pairing_confirm = pairing_confirm,
};

static bool mds_access_enable(struct bt_conn *conn)
{
	if (mds_conn && (conn == mds_conn)) {
		return true;
	}

	return false;
}

static const struct bt_mds_cb mds_cb = {
	.access_enable = mds_access_enable,
};

static void button_handler(uint32_t button_state, uint32_t has_changed)
{
	static bool time_measure_start;

	int err;
	uint32_t buttons = button_state & has_changed;

	if ((buttons & DK_BTN1_MSK) & !pairing_confirmation_conn) {
		time_measure_start = !time_measure_start;

		if (time_measure_start) {
			err = MEMFAULT_METRIC_TIMER_START(button_1_elapsed_time_ms);
			if (err) {
				printk("Failed to start memfault metrics timer: %d\n", err);
			}
		} else {
			err = MEMFAULT_METRIC_TIMER_STOP(button_1_elapsed_time_ms);
			if (err) {
				printk("Failed to stop memfault metrics: %d\n", err);
			}

			/* Trigger collection of heartbeat data. */
			memfault_metrics_heartbeat_debug_trigger();
		}
	}

	if (buttons & DK_BTN1_MSK) {
		if (pairing_confirmation_conn) {
			err = bt_conn_auth_pairing_confirm(pairing_confirmation_conn);
			if (err) {
				printk("Failed to confirm the pairing: %d\n", err);
			} else {
				printk("Pairing confirmed\n");
			}

			pairing_confirmation_conn = NULL;
		}
	}

	if ((has_changed & DK_BTN2_MSK) && !pairing_confirmation_conn) {
		bool button_state = (buttons & DK_BTN2_MSK) ? 1 : 0;

		MEMFAULT_TRACE_EVENT_WITH_LOG(button_2_state_changed, "Button state: %u",
					      button_state);

		printk("button_2_state_changed event has been tracked, button state: %u\n",
		       button_state);
	}

	if (buttons & DK_BTN2_MSK) {
		if (pairing_confirmation_conn) {
			err = bt_conn_auth_cancel(pairing_confirmation_conn);
			if (err) {
				printk("Failed to reject the pairing: %d\n", err);
			} else {
				printk("Pairing rejected\n");
			}

			pairing_confirmation_conn = NULL;
		}
	}

	if (buttons & DK_BTN3_MSK) {
		err = MEMFAULT_METRIC_ADD(button_3_press_count, 1);
		if (err) {
			printk("Failed to increase button_3_press_count metric: %d\n", err);
		} else {
			printk("button_3_press_count metric increased\n");
		}
	}

	if (buttons & DK_BTN4_MSK) {
		volatile uint32_t i;

		printk("Division by zero will now be triggered\n");
#pragma GCC diagnostic push
#pragma GCC diagnostic ignored "-Wdiv-by-zero"
		i = 1 / 0;
#pragma GCC diagnostic pop
		ARG_UNUSED(i);
	}
}

static void bas_notify(void)
{
	int err;
	uint8_t battery_level = bt_bas_get_battery_level();

	__ASSERT_NO_MSG(battery_level > 0);

	battery_level--;

	if (battery_level == 0) {
		battery_level = 100U;
	}

	err = MEMFAULT_METRIC_SET_UNSIGNED(battery_soc_pct, battery_level);
	if (err) {
		printk("Failed to set battery_soc_pct memfault metrics (err %d)\n", err);
	}

	bt_bas_set_battery_level(battery_level);
}

static void bas_work_handler(struct k_work *work)
{
	bas_notify();
	k_work_reschedule((struct k_work_delayable *)work, K_SECONDS(1));
}

// Add shell commands to init and deinit Memfault MDS service if needed
static int init_mds(const struct shell *shell, size_t argc, char **argv)
{
#if defined(CONFIG_BT_GATT_DYNAMIC_DB)
	int err = bt_mds_init();
	if (err) {
		shell_print(shell, "Failed to initialize MDS service (err %d)", err);
		return err;
	}
	shell_print(shell, "MDS service initialized");
	return 0;
#else
	shell_print(shell, "MDS dynamic DB support not enabled");
	return -ENOTSUP;
#endif
}
static int deinit_mds(const struct shell *shell, size_t argc, char **argv)
{
#if defined(CONFIG_BT_GATT_DYNAMIC_DB)
	int err = bt_mds_uninit();
	if (err) {
		shell_print(shell, "Failed to uninitialize MDS service (err %d)", err);
		return err;
	}
	shell_print(shell, "MDS service uninitialized");
	return 0;
#else
	shell_print(shell, "MDS dynamic DB support not enabled");
	return -ENOTSUP;
#endif
}
SHELL_STATIC_SUBCMD_SET_CREATE(sub_mds,
	SHELL_CMD(init, NULL, "Initialize Memfault Diagnostic Service", init_mds),
	SHELL_CMD(deinit, NULL, "Deinitialize Memfault Diagnostic Service", deinit_mds),
	SHELL_SUBCMD_SET_END
);
SHELL_CMD_REGISTER(mds, &sub_mds, "Memfault Diagnostic Service commands", NULL);

int main(void)
{
	uint32_t blink_status = 0;
	int err;

	printk("Starting Bluetooth Memfault example\n");

	err = dk_leds_init();
	if (err) {
		printk("LEDs init failed (err %d)\n", err);
		return 0;
	}

	err = dk_buttons_init(button_handler);
	if (err) {
		printk("Failed to initialize buttons (err %d)\n", err);
		return 0;
	}

	err = bt_mds_cb_register(&mds_cb);
	if (err) {
		printk("Memfault Diagnostic service callback registration failed (err %d)\n", err);
		return 0;
	}

	err = bt_enable(NULL);
	if (err) {
		printk("Bluetooth init failed (err %d)\n", err);
		return 0;
	}

	err = bt_conn_auth_cb_register(&conn_auth_callbacks);
	if (err) {
		printk("Failed to register authorization callbacks (err %d)\n", err);
		return 0;
	}

	err = bt_conn_auth_info_cb_register(&conn_auth_info_callbacks);
	if (err) {
		printk("Failed to register authorization info callbacks (err %d)\n", err);
		return 0;
	}

	printk("Bluetooth initialized\n");

	if (IS_ENABLED(CONFIG_SETTINGS)) {
		err = settings_load();
		if (err) {
			printk("Failed to load settings (err %d)\n", err);
			return 0;
		}
	}

	err = bt_le_adv_start(BT_LE_ADV_CONN, ad, ARRAY_SIZE(ad),
			      sd, ARRAY_SIZE(sd));
	if (err) {
		printk("Advertising failed to start (err %d)\n", err);
		return 0;
	}

	printk("Advertising successfully started\n");

	#if defined(CONFIG_BT_GATT_DYNAMIC_DB)
	bt_mds_init();
	#endif

	k_work_schedule(&bas_work, K_SECONDS(1));

	for (;;) {
		dk_set_led(RUN_STATUS_LED, (++blink_status) % 2);
		k_sleep(K_MSEC(RUN_LED_BLINK_INTERVAL));
	}
}
```
